## uart/components/uart/Kconfig
```kconfig
menu "UART Configuration"
orsource "$IDF_PATH/examples/common_components/env_caps/$IDF_TARGET/Kconfig.env_caps"

    config UART_TX_PIN
        int "UART_TX_PIN"
        range ENV_GPIO_RANGE_MIN ENV_GPIO_OUT_RANGE_MAX
        default 43
        help
            no help

    config UART_RX_PIN
        int "UART_RX_PIN"
        range ENV_GPIO_RANGE_MIN ENV_GPIO_OUT_RANGE_MAX
        default 44
        help
            no help

     config UART_NUM
        int "UART_NUM"
        range UART_NUM_0 UART_NUM_2
        default UART_NUM_0
        help
            no help

    config BAUD_RATE
        int "BAUD_RATE"
        range 0 10000000
        default 115200
        help
            no help



endmenu
```
